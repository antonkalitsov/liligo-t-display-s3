/*
  T-Display-S3 BLE Ticker
  ------------------------------------------------------------
  - Shows text presets (text, font, size, colors, animation, speed, brightness)
  - Presets are uploaded over Bluetooth LE from the web app and stored in flash
  - Runs standalone afterwards

  Buttons
    KEY  (GPIO14)  short  = next preset
                   long   = power off (deep sleep). Press KEY again to wake.
    BOOT (GPIO0)   short  = Bluetooth on/off (on for 2 min, or while connected)
                   long   = info screen (battery, Bluetooth name)

  BLE protocol: newline-terminated JSON on the RX characteristic,
  replies as newline-terminated JSON notifications on TX (sent in chunks).
*/
#include <Arduino.h>
#include <Preferences.h>
#include <ArduinoJson.h>
#include <NimBLEDevice.h>
#include <esp_sleep.h>
#include <driver/gpio.h>
#include <driver/rtc_io.h>
#include <vector>
#include "lgfx_config.h"
#include "fonts/fonts.h"  // Latin + Cyrillic fonts (generated by tools/make_fonts.py)

// ---------------------------------------------------------------- settings
#define FW_VERSION "1.1.0"
#define ENABLE_LIGHT_SLEEP 1          // sleep the CPU between frames on battery. Set 0 if the screen flickers.
#define BLE_IDLE_TIMEOUT_MS 120000UL  // Bluetooth turns itself off after 2 min without a connection
#define LONG_PRESS_MS 1200
#define MAX_PRESETS 16
#define MAX_TEXT_LEN 240  // bytes (Cyrillic letters take 2 bytes each)
#define LOW_BAT_MV 3300

// ---------------------------------------------------------------- pins
#define PIN_POWER_ON 15
#define PIN_LCD_BL 38
#define PIN_BTN_BOOT 0
#define PIN_BTN_KEY 14
#define PIN_BAT_ADC 4

// ---------------------------------------------------------------- BLE ids (must match web app)
static const char *SVC_UUID = "6e5a1000-3d2a-4c6b-9b8e-5f1c2a7d9e01";
static const char *RX_UUID = "6e5a1001-3d2a-4c6b-9b8e-5f1c2a7d9e01";  // phone -> board (write)
static const char *TX_UUID = "6e5a1002-3d2a-4c6b-9b8e-5f1c2a7d9e01";  // board -> phone (notify)

// ---------------------------------------------------------------- data
enum Anim : uint8_t { ANIM_STATIC, ANIM_SCROLL, ANIM_BLINK, ANIM_TYPE, ANIM_BOUNCE, ANIM_RAINBOW, ANIM_COUNT };
static const char *ANIM_NAMES[ANIM_COUNT] = {"static", "scroll", "blink", "type", "bounce", "rainbow"};

struct Preset {
  String text = "Hello";
  uint8_t font = 0;   // 0 sans, 1 serif, 2 mono
  uint8_t size = 5;   // 1..8
  uint32_t fg = 0xFFFFFF;
  uint32_t bg = 0x000000;
  uint8_t anim = ANIM_SCROLL;
  uint8_t speed = 5;  // 1..10
  uint8_t bright = 12; // 1..16
  int8_t dir = -1;    // scroll: -1 = moves left, 1 = moves right
};

static std::vector<Preset> presets;
static int curIdx = 0;
static int autoOffMin = 0;  // 0 = never
static bool flipScreen = false;
static bool previewActive = false;
static Preset previewPreset;

static LGFX lcd;
static LGFX_Sprite canvas(&lcd);
static Preferences prefs;

static const int W = 320, H = 170;
static uint32_t animStart = 0;
static uint32_t lastActivity = 0;
static String toastText;
static uint32_t toastUntil = 0;
static uint32_t infoUntil = 0;
static bool needRedraw = true;

// ---------------------------------------------------------------- BLE state
static bool bleOn = false;
static volatile bool bleConnected = false;
static volatile uint16_t bleMtu = 23;
static uint32_t bleIdleSince = 0;
static NimBLECharacteristic *txChar = nullptr;
static SemaphoreHandle_t rxMutex;
static std::string rxAccum;
static std::vector<std::string> rxLines;
static String bleName;

// ================================================================= helpers
static const Preset &active() {
  if (previewActive) return previewPreset;
  return presets[curIdx];
}

static uint16_t to565(uint32_t rgb) { return lcd.color565((rgb >> 16) & 0xFF, (rgb >> 8) & 0xFF, rgb & 0xFF); }

static uint32_t parseColor(const char *s, uint32_t def) {
  if (!s) return def;
  if (*s == '#') s++;
  if (strlen(s) != 6) return def;
  return strtoul(s, nullptr, 16) & 0xFFFFFF;
}

static String colorStr(uint32_t c) {
  char b[8];
  snprintf(b, sizeof(b), "#%06lX", (unsigned long)c);
  return String(b);
}

static void toast(const String &s, uint32_t ms = 1500) {
  toastText = s;
  toastUntil = millis() + ms;
  needRedraw = true;
}

// ---- UTF-8 helpers (Cyrillic letters are 2 bytes)
static int utf8CharLen(uint8_t c) {
  if (c < 0x80) return 1;
  if ((c & 0xE0) == 0xC0) return 2;
  if ((c & 0xF0) == 0xE0) return 3;
  if ((c & 0xF8) == 0xF0) return 4;
  return 1;
}
static int utf8Count(const String &s) {
  int n = 0;
  for (unsigned i = 0; i < s.length(); i += utf8CharLen(s[i])) n++;
  return n;
}
static String utf8Prefix(const String &s, int chars) {
  unsigned i = 0;
  while (chars-- > 0 && i < s.length()) i += utf8CharLen(s[i]);
  return s.substring(0, min(i, s.length()));
}
static String utf8Truncate(const String &s, unsigned maxBytes) {
  if (s.length() <= maxBytes) return s;
  unsigned i = 0;
  while (i < s.length()) {
    unsigned n = utf8CharLen(s[i]);
    if (i + n > maxBytes) break;
    i += n;
  }
  return s.substring(0, i);
}

// AW9364 backlight driver: 16 levels, set by counting pulses. 0 = off.
static void setBacklight(uint8_t value) {
  static uint8_t level = 0;
  const uint8_t steps = 16;
  if (value > 16) value = 16;
  if (value == 0) {
    digitalWrite(PIN_LCD_BL, LOW);
    delay(3);
    level = 0;
    return;
  }
  if (level == 0) {
    digitalWrite(PIN_LCD_BL, HIGH);
    level = steps;
    delayMicroseconds(30);
  }
  int from = steps - level;
  int to = steps - value;
  int num = (steps + to - from) % steps;
  for (int i = 0; i < num; i++) {
    digitalWrite(PIN_LCD_BL, LOW);
    digitalWrite(PIN_LCD_BL, HIGH);
  }
  level = value;
}

static uint32_t readBatteryMv() {
  uint32_t sum = 0;
  for (int i = 0; i < 8; i++) sum += analogReadMilliVolts(PIN_BAT_ADC);
  return (sum / 8) * 2;  // 1:2 divider on the board
}

static int batteryPercent(uint32_t mv) {
  if (mv >= 4150) return 100;
  if (mv <= 3300) return 0;
  return (int)((mv - 3300) * 100 / (4150 - 3300));
}

static bool usbPowered() {
  // USB host connected (serial enumerated) or voltage above what a LiPo can show
  return (bool)Serial || readBatteryMv() > 4400;
}

// ================================================================= presets <-> JSON
static void presetToJson(const Preset &p, JsonObject o) {
  o["text"] = p.text;
  o["font"] = p.font;
  o["size"] = p.size;
  o["fg"] = colorStr(p.fg);
  o["bg"] = colorStr(p.bg);
  o["anim"] = ANIM_NAMES[p.anim];
  o["speed"] = p.speed;
  o["bright"] = p.bright;
  o["dir"] = p.dir < 0 ? "left" : "right";
}

static Preset presetFromJson(JsonObjectConst o) {
  Preset p;
  String t = o["text"] | "Hello";
  p.text = utf8Truncate(t, MAX_TEXT_LEN);
  p.font = constrain((int)(o["font"] | 0), 0, 2);
  p.size = constrain((int)(o["size"] | 5), 1, 8);
  p.fg = parseColor(o["fg"] | "#FFFFFF", 0xFFFFFF);
  p.bg = parseColor(o["bg"] | "#000000", 0x000000);
  const char *a = o["anim"] | "scroll";
  p.anim = ANIM_SCROLL;
  for (int i = 0; i < ANIM_COUNT; i++)
    if (strcmp(a, ANIM_NAMES[i]) == 0) p.anim = i;
  p.speed = constrain((int)(o["speed"] | 5), 1, 10);
  p.bright = constrain((int)(o["bright"] | 12), 1, 16);
  const char *d = o["dir"] | "left";
  p.dir = strcmp(d, "right") == 0 ? 1 : -1;
  return p;
}

static String configToJson(const char *type) {
  JsonDocument doc;
  if (type) doc["type"] = type;
  doc["autoOff"] = autoOffMin;
  doc["flip"] = flipScreen;
  doc["cur"] = curIdx;
  JsonArray arr = doc["presets"].to<JsonArray>();
  for (auto &p : presets) presetToJson(p, arr.add<JsonObject>());
  String out;
  serializeJson(doc, out);
  return out;
}

static bool applyConfigJson(JsonObjectConst root) {
  JsonArrayConst arr = root["presets"];
  if (arr.isNull() || arr.size() == 0) return false;
  presets.clear();
  for (JsonVariantConst v : arr) {
    if (presets.size() >= MAX_PRESETS) break;
    presets.push_back(presetFromJson(v.as<JsonObjectConst>()));
  }
  autoOffMin = constrain((int)(root["autoOff"] | autoOffMin), 0, 240);
  flipScreen = root["flip"] | flipScreen;
  if (curIdx >= (int)presets.size()) curIdx = 0;
  return true;
}

static void loadDefaults() {
  presets.clear();
  Preset a; a.text = "Hello! :)"; a.anim = ANIM_SCROLL; a.fg = 0x00E5FF; a.size = 6;
  Preset b; b.text = "T-Display"; b.anim = ANIM_RAINBOW; b.size = 5;
  Preset c; c.text = "Press BOOT for Bluetooth"; c.anim = ANIM_TYPE; c.fg = 0xFFD600; c.bg = 0x0A1A40; c.size = 3; c.speed = 6;
  presets.push_back(a);
  presets.push_back(b);
  presets.push_back(c);
}

static void saveConfig() {
  prefs.putString("cfg", configToJson(nullptr));
  prefs.putInt("cur", curIdx);
}

static void loadConfig() {
  String s = prefs.getString("cfg", "");
  bool ok = false;
  if (s.length()) {
    JsonDocument doc;
    if (!deserializeJson(doc, s)) ok = applyConfigJson(doc.as<JsonObjectConst>());
  }
  if (!ok) loadDefaults();
  curIdx = prefs.getInt("cur", 0);
  if (curIdx < 0 || curIdx >= (int)presets.size()) curIdx = 0;
}

// ================================================================= rendering
static void applyFont(const Preset &p) {
  // size level 1..8 -> (font index, scale). Levels 7 and 8 reuse the two largest fonts at 2x.
  static const uint8_t fIdx[8] = {0, 1, 2, 3, 4, 5, 4, 5};
  static const uint8_t fScale[8] = {1, 1, 1, 1, 1, 1, 2, 2};
  const lgfx::IFont *const *set = p.font == 1 ? FONTS_SERIF : (p.font == 2 ? FONTS_MONO : FONTS_SANS);
  int s = constrain(p.size, 1, 8) - 1;
  canvas.setFont(set[fIdx[s]]);
  canvas.setTextSize(fScale[s]);
}

static uint16_t hueColor(uint32_t hue) {
  hue %= 360;
  uint8_t x = (uint8_t)((hue % 60) * 255 / 60);
  uint8_t r, g, b;
  switch (hue / 60) {
    case 0: r = 255; g = x; b = 0; break;
    case 1: r = 255 - x; g = 255; b = 0; break;
    case 2: r = 0; g = 255; b = x; break;
    case 3: r = 0; g = 255 - x; b = 255; break;
    case 4: r = x; g = 0; b = 255; break;
    default: r = 255; g = 0; b = 255 - x; break;
  }
  return lcd.color565(r, g, b);
}

// draws text left-aligned at x (vertical centre y), one colour per character
static void drawRainbow(const String &text, int x, int y, uint32_t hueBase) {
  char buf[5];
  int idx = 0;
  for (unsigned i = 0; i < text.length();) {
    int n = utf8CharLen(text[i]);
    int k = 0;
    for (; k < n && i + k < text.length(); k++) buf[k] = text[i + k];
    buf[k] = 0;
    i += n;
    canvas.setTextColor(hueColor(hueBase + idx++ * 25));
    canvas.drawString(buf, x, y);
    x += canvas.textWidth(buf);
  }
}

// returns true if the frame is animated (needs periodic redraw)
static bool renderFrame(uint32_t now) {
  const Preset &p = active();
  uint32_t t = now - animStart;
  bool animated = true;

  canvas.fillScreen(to565(p.bg));
  applyFont(p);
  canvas.setTextDatum(textdatum_t::middle_left);
  canvas.setTextColor(to565(p.fg));

  const String &text = p.text;
  int tw = canvas.textWidth(text);
  int th = canvas.fontHeight();
  int cy = H / 2;
  int cx = (W - tw) / 2;
  float pxPerSec = 20 + p.speed * 25;  // 45 .. 270 px/s
  uint8_t anim = p.anim;

  // Text too wide to fit? static/blink/type/rainbow fall back to scrolling.
  bool tooWide = tw > W - 8;
  if (tooWide && (anim == ANIM_STATIC || anim == ANIM_BLINK)) anim = ANIM_SCROLL;

  switch (anim) {
    case ANIM_STATIC:
      canvas.drawString(text, cx, cy);
      animated = false;
      break;

    case ANIM_SCROLL: {
      int span = tw + W;
      int off = (int)((uint64_t)t * (uint32_t)pxPerSec / 1000) % span;
      int x = p.dir < 0 ? W - off : off - tw;
      canvas.drawString(text, x, cy);
      break;
    }

    case ANIM_BLINK: {
      uint32_t period = 1100 - p.speed * 100;  // 1000 .. 100 ms
      if ((t / period) % 2 == 0) canvas.drawString(text, cx, cy);
      break;
    }

    case ANIM_TYPE: {
      uint32_t cps = p.speed * 3;  // characters per second
      int len = utf8Count(text);
      int total = len + (int)(cps * 2);  // pause ~2 s at the end
      int n = (int)((uint64_t)t * cps / 1000) % (total > 0 ? total : 1);
      if (n > len) n = len;
      String part = utf8Prefix(text, n);
      int x = tooWide ? 4 : cx;
      int pw = canvas.textWidth(part);
      if (tooWide && pw > W - 16) x = W - 16 - pw;  // keep the cursor on screen
      canvas.drawString(part, x, cy);
      if ((t / 400) % 2 == 0) canvas.fillRect(x + pw + 2, cy - th / 3, max(3, th / 8), th * 2 / 3, to565(p.fg));
      break;
    }

    case ANIM_BOUNCE: {
      int rangeX = abs(W - tw);
      int rangeY = max(0, H - th);
      float d = (float)t * pxPerSec / 1000.0f;
      int px = rangeX ? (int)d % (2 * rangeX) : 0;
      if (px > rangeX) px = 2 * rangeX - px;
      int py = rangeY ? (int)(d * 0.6f) % (2 * rangeY) : 0;
      if (py > rangeY) py = 2 * rangeY - py;
      int x = tw <= W ? px : -px;
      canvas.drawString(text, x, th / 2 + py);
      break;
    }

    case ANIM_RAINBOW: {
      uint32_t hue = (uint32_t)((uint64_t)t * p.speed * 30 / 1000);
      int x = cx;
      if (tooWide) {
        int span = tw + W;
        x = W - (int)((uint64_t)t * (uint32_t)pxPerSec / 1000) % span;
      }
      drawRainbow(text, x, cy, hue);
      break;
    }
  }

  // ---- overlays
  canvas.setFont(&fonts::Font2);
  canvas.setTextSize(1);
  if (bleOn) {
    uint16_t c = bleConnected ? TFT_GREEN : ((now / 500) % 2 ? TFT_BLUE : 0x001F);
    canvas.fillRoundRect(W - 30, 3, 27, 16, 4, c);
    canvas.setTextColor(TFT_WHITE);
    canvas.setTextDatum(textdatum_t::middle_center);
    canvas.drawString("BT", W - 16, 11);
    animated = true;
  }
  if (previewActive) {
    canvas.fillRoundRect(3, 3, 64, 16, 4, TFT_ORANGE);
    canvas.setTextColor(TFT_BLACK);
    canvas.setTextDatum(textdatum_t::middle_center);
    canvas.drawString("PREVIEW", 35, 11);
  }
  if (now < toastUntil) {
    int w = canvas.textWidth(toastText) + 16;
    canvas.fillRoundRect((W - w) / 2, H - 24, w, 20, 6, 0x2104);
    canvas.setTextColor(TFT_WHITE);
    canvas.setTextDatum(textdatum_t::middle_center);
    canvas.drawString(toastText, W / 2, H - 14);
    animated = true;
  }
  if (now < infoUntil) {
    uint32_t mv = readBatteryMv();
    canvas.fillRoundRect(20, 20, W - 40, H - 40, 10, 0x18E3);
    canvas.setTextColor(TFT_WHITE);
    canvas.setTextDatum(textdatum_t::top_left);
    canvas.setFont(&fonts::FreeSansBold9pt7b);
    char line[64];
    if (mv > 4400) snprintf(line, sizeof(line), "Battery: USB power");
    else snprintf(line, sizeof(line), "Battery: %d%%  (%.2f V)", batteryPercent(mv), mv / 1000.0);
    canvas.drawString(line, 34, 32);
    snprintf(line, sizeof(line), "Preset: %d / %d", curIdx + 1, (int)presets.size());
    canvas.drawString(line, 34, 58);
    canvas.drawString(("BT name: " + bleName).c_str(), 34, 84);
    snprintf(line, sizeof(line), "Auto-off: %s", autoOffMin ? (String(autoOffMin) + " min").c_str() : "never");
    canvas.drawString(line, 34, 110);
    animated = true;
  }

  canvas.pushSprite(0, 0);
  return animated;
}

// ================================================================= BLE
class RxCallbacks : public NimBLECharacteristicCallbacks {
  void onWrite(NimBLECharacteristic *c) override {
    std::string v = c->getValue();
    xSemaphoreTake(rxMutex, portMAX_DELAY);
    for (char ch : v) {
      if (ch == '\n') {
        if (!rxAccum.empty()) rxLines.push_back(rxAccum);
        rxAccum.clear();
      } else if (rxAccum.size() < 8192) {
        rxAccum += ch;
      }
    }
    xSemaphoreGive(rxMutex);
  }
};

class ServerCallbacks : public NimBLEServerCallbacks {
  void onConnect(NimBLEServer *s, ble_gap_conn_desc *desc) override {
    bleConnected = true;
    bleMtu = 23;
  }
  void onDisconnect(NimBLEServer *s) override {
    bleConnected = false;
    bleIdleSince = millis();
  }
  void onMTUChange(uint16_t MTU, ble_gap_conn_desc *desc) override { bleMtu = MTU; }
};

static void bleStart() {
  if (bleOn) return;
  NimBLEDevice::init(bleName.c_str());
  NimBLEDevice::setMTU(247);
  NimBLEServer *server = NimBLEDevice::createServer();
  server->setCallbacks(new ServerCallbacks());
  NimBLEService *svc = server->createService(SVC_UUID);
  NimBLECharacteristic *rx = svc->createCharacteristic(RX_UUID, NIMBLE_PROPERTY::WRITE | NIMBLE_PROPERTY::WRITE_NR);
  rx->setCallbacks(new RxCallbacks());
  txChar = svc->createCharacteristic(TX_UUID, NIMBLE_PROPERTY::NOTIFY | NIMBLE_PROPERTY::READ);
  svc->start();
  NimBLEAdvertising *adv = NimBLEDevice::getAdvertising();
  adv->addServiceUUID(SVC_UUID);
  adv->setScanResponse(true);
  adv->start();
  bleOn = true;
  bleConnected = false;
  bleIdleSince = millis();
  toast("Bluetooth ON: " + bleName, 2500);
}

static void bleStop() {
  if (!bleOn) return;
  NimBLEDevice::deinit(true);
  txChar = nullptr;
  bleOn = false;
  bleConnected = false;
  if (previewActive) {
    previewActive = false;
    animStart = millis();
  }
  toast("Bluetooth OFF");
}

static void bleSend(const String &s) {
  if (!bleConnected || !txChar) return;
  String msg = s + "\n";
  size_t chunk = bleMtu > 23 ? bleMtu - 3 : 20;
  if (chunk > 180) chunk = 180;
  const uint8_t *data = (const uint8_t *)msg.c_str();
  size_t len = msg.length();
  for (size_t i = 0; i < len; i += chunk) {
    size_t n = min(chunk, len - i);
    txChar->setValue(data + i, n);
    txChar->notify();
    delay(10);
  }
}

static String statusJson() {
  JsonDocument doc;
  doc["type"] = "status";
  doc["ver"] = FW_VERSION;
  uint32_t mv = readBatteryMv();
  doc["bat_mv"] = mv;
  doc["bat_pct"] = batteryPercent(mv);
  doc["usb"] = mv > 4400;
  doc["cur"] = curIdx;
  doc["count"] = presets.size();
  doc["max"] = MAX_PRESETS;
  String out;
  serializeJson(doc, out);
  return out;
}

static void goToSleep();

static void handleCommand(const std::string &line) {
  JsonDocument doc;
  if (deserializeJson(doc, line)) {
    bleSend("{\"type\":\"error\",\"msg\":\"bad json\"}");
    return;
  }
  const char *cmd = doc["cmd"] | "";
  lastActivity = millis();

  if (!strcmp(cmd, "get")) {
    bleSend(configToJson("config"));
  } else if (!strcmp(cmd, "status")) {
    bleSend(statusJson());
  } else if (!strcmp(cmd, "set")) {
    if (applyConfigJson(doc.as<JsonObjectConst>())) {
      previewActive = false;
      if (doc["cur"].is<int>()) curIdx = constrain((int)doc["cur"], 0, (int)presets.size() - 1);
      saveConfig();
      lcd.setRotation(flipScreen ? 3 : 1);
      setBacklight(active().bright);
      animStart = millis();
      toast("Saved " + String(presets.size()) + " presets");
      bleSend("{\"type\":\"ok\",\"cmd\":\"set\"}");
    } else {
      bleSend("{\"type\":\"error\",\"msg\":\"no presets\"}");
    }
  } else if (!strcmp(cmd, "preview")) {
    previewPreset = presetFromJson(doc["preset"].as<JsonObjectConst>());
    previewActive = true;
    setBacklight(previewPreset.bright);
    animStart = millis();
    bleSend("{\"type\":\"ok\",\"cmd\":\"preview\"}");
  } else if (!strcmp(cmd, "select")) {
    int i = doc["i"] | 0;
    if (i >= 0 && i < (int)presets.size()) {
      curIdx = i;
      previewActive = false;
      prefs.putInt("cur", curIdx);
      setBacklight(active().bright);
      animStart = millis();
    }
    bleSend("{\"type\":\"ok\",\"cmd\":\"select\"}");
  } else if (!strcmp(cmd, "sleep")) {
    bleSend("{\"type\":\"ok\",\"cmd\":\"sleep\"}");
    delay(100);
    goToSleep();
  } else {
    bleSend("{\"type\":\"error\",\"msg\":\"unknown cmd\"}");
  }
  needRedraw = true;
}

static void processBle() {
  if (!bleOn) return;
  std::vector<std::string> lines;
  xSemaphoreTake(rxMutex, portMAX_DELAY);
  lines.swap(rxLines);
  xSemaphoreGive(rxMutex);
  for (auto &l : lines) handleCommand(l);

  if (bleConnected) bleIdleSince = millis();
  else if (millis() - bleIdleSince > BLE_IDLE_TIMEOUT_MS) bleStop();
}

// ================================================================= power
static void goToSleep() {
  canvas.fillScreen(TFT_BLACK);
  canvas.setFont(&fonts::FreeSansBold18pt7b);
  canvas.setTextSize(1);
  canvas.setTextColor(TFT_DARKGREY);
  canvas.setTextDatum(textdatum_t::middle_center);
  canvas.drawString("Bye", W / 2, H / 2);
  canvas.pushSprite(0, 0);
  delay(500);

  bleStop();
  prefs.putInt("cur", curIdx);
  prefs.end();

  lcd.sleep();  // ST7789 SLPIN
  setBacklight(0);
  digitalWrite(PIN_POWER_ON, LOW);  // cut LCD / peripheral power
  gpio_hold_en((gpio_num_t)PIN_POWER_ON);
  gpio_hold_en((gpio_num_t)PIN_LCD_BL);
  gpio_deep_sleep_hold_en();

  // wait until KEY is released, otherwise we wake up immediately
  while (digitalRead(PIN_BTN_KEY) == LOW) delay(10);
  delay(50);

  rtc_gpio_pullup_en(GPIO_NUM_14);
  rtc_gpio_pulldown_dis(GPIO_NUM_14);
  esp_sleep_enable_ext0_wakeup(GPIO_NUM_14, 0);
  esp_deep_sleep_start();
}

static void idleWait(uint32_t ms, bool buttonsDown) {
  if (ms == 0) return;
#if ENABLE_LIGHT_SLEEP
  static uint32_t usbCheckAt = 0;
  static bool onUsb = true;
  if (millis() - usbCheckAt > 5000) {
    onUsb = usbPowered();
    usbCheckAt = millis();
  }
  if (!bleOn && !onUsb && !buttonsDown && ms > 5) {
    esp_sleep_enable_timer_wakeup((uint64_t)ms * 1000ULL);
    gpio_wakeup_enable((gpio_num_t)PIN_BTN_KEY, GPIO_INTR_LOW_LEVEL);
    gpio_wakeup_enable((gpio_num_t)PIN_BTN_BOOT, GPIO_INTR_LOW_LEVEL);
    esp_sleep_enable_gpio_wakeup();
    esp_light_sleep_start();
    return;
  }
#endif
  delay(ms);
}

// ================================================================= buttons
struct Button {
  uint8_t pin;
  bool down = false;
  bool longFired = false;
  bool ignore = false;  // ignore the press that woke us up
  uint32_t t0 = 0;
  explicit Button(uint8_t p) : pin(p) {}
};
static Button btnKey(PIN_BTN_KEY);
static Button btnBoot(PIN_BTN_BOOT);

// returns 0 = nothing, 1 = short press, 2 = long press
static int pollButton(Button &b) {
  bool pressed = digitalRead(b.pin) == LOW;
  uint32_t now = millis();
  if (pressed && !b.down) {
    b.down = true;
    b.t0 = now;
    b.longFired = false;
  } else if (pressed && b.down) {
    if (!b.longFired && !b.ignore && now - b.t0 >= LONG_PRESS_MS) {
      b.longFired = true;
      return 2;
    }
  } else if (!pressed && b.down) {
    b.down = false;
    bool wasIgnored = b.ignore;
    b.ignore = false;
    if (!wasIgnored && !b.longFired && now - b.t0 > 30) return 1;
  }
  return 0;
}

static void nextPreset() {
  previewActive = false;
  curIdx = (curIdx + 1) % presets.size();
  prefs.putInt("cur", curIdx);
  setBacklight(active().bright);
  animStart = millis();
  toast(String(curIdx + 1) + " / " + String(presets.size()), 900);
}

// ================================================================= setup / loop
void setup() {
  gpio_hold_dis((gpio_num_t)PIN_POWER_ON);
  gpio_hold_dis((gpio_num_t)PIN_LCD_BL);
  gpio_deep_sleep_hold_dis();

  pinMode(PIN_POWER_ON, OUTPUT);
  digitalWrite(PIN_POWER_ON, HIGH);  // required on battery, or the LCD stays dark
  pinMode(PIN_LCD_BL, OUTPUT);
  digitalWrite(PIN_LCD_BL, LOW);
  pinMode(PIN_BTN_KEY, INPUT_PULLUP);
  pinMode(PIN_BTN_BOOT, INPUT_PULLUP);
  gpio_sleep_sel_dis((gpio_num_t)PIN_POWER_ON);  // keep these pins driven during light sleep
  gpio_sleep_sel_dis((gpio_num_t)PIN_LCD_BL);

  Serial.begin(115200);
#if ARDUINO_USB_MODE
  Serial.setTxTimeoutMs(0);  // never block when no USB host is listening
#endif
  setCpuFrequencyMhz(80);
  analogReadResolution(12);

  rxMutex = xSemaphoreCreateMutex();
  uint64_t mac = ESP.getEfuseMac();
  char nm[20];
  snprintf(nm, sizeof(nm), "TDisplay-%02X%02X", (uint8_t)(mac >> 32), (uint8_t)(mac >> 40));
  bleName = nm;

  prefs.begin("ticker", false);
  loadConfig();

  lcd.init();
  lcd.setRotation(flipScreen ? 3 : 1);
  lcd.fillScreen(TFT_BLACK);
  canvas.setColorDepth(16);
  canvas.setPsram(false);
  canvas.createSprite(W, H);

  if (esp_sleep_get_wakeup_cause() == ESP_SLEEP_WAKEUP_EXT0) btnKey.ignore = true;
  if (digitalRead(PIN_BTN_KEY) == LOW) btnKey.ignore = true;

  animStart = millis();
  lastActivity = millis();
  renderFrame(millis());
  setBacklight(active().bright);
}

void loop() {
  uint32_t now = millis();

  int k = pollButton(btnKey);
  int b = pollButton(btnBoot);
  if (k || b) {
    lastActivity = now;
    needRedraw = true;
  }
  if (k == 1) nextPreset();
  if (k == 2) goToSleep();
  if (b == 1) {
    if (bleOn) bleStop();
    else bleStart();
  }
  if (b == 2) infoUntil = now + 3000;

  processBle();

  // auto power-off
  if (autoOffMin > 0 && !bleConnected && now - lastActivity > (uint32_t)autoOffMin * 60000UL) goToSleep();

  // low battery protection (checked every 30 s)
  static uint32_t batCheckAt = 0;
  static uint8_t lowCount = 0;
  if (now - batCheckAt > 30000) {
    batCheckAt = now;
    uint32_t mv = readBatteryMv();
    lowCount = (mv < LOW_BAT_MV && mv > 1000) ? lowCount + 1 : 0;
    if (lowCount >= 3) {
      toast("Battery low - turning off", 2000);
      renderFrame(millis());
      delay(2000);
      goToSleep();
    }
  }

  static bool animated = true;
  static uint32_t lastFrame = 0;
  const uint32_t frameMs = 33;  // ~30 fps
  if (animated || needRedraw) {
    if (now - lastFrame >= frameMs || needRedraw) {
      lastFrame = now;
      needRedraw = false;
      animated = renderFrame(now);
    }
  }

  bool anyDown = btnKey.down || btnBoot.down;
  uint32_t wait;
  if (anyDown) wait = 15;                 // measure press length
  else if (bleOn) wait = 20;              // stay responsive while connected
  else if (animated) {
    uint32_t el = millis() - lastFrame;
    wait = el >= frameMs ? 1 : frameMs - el;
  } else wait = 1000;                     // static text: wake once a second (buttons wake instantly)
  idleWait(wait, anyDown);
}
